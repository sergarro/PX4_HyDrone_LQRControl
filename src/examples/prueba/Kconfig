## src/examples/prueba/Kconfig
```kconfig
menuconfig EXAMPLES_PRUEBA
	bool "prueba"
	default n
	---help---
		Enable support for prueba
```

## src/examples/prueba2/Kconfig
```kconfig
menuconfig EXAMPLES_PRUEBA2
	bool "prueba2"
	default n
	---help---
		Enable support for prueba2
```

## src/modules/prueba/Kconfig
```kconfig
menuconfig MODULES_PRUEBA
	bool "prueba"
	default n
	---help---
		Enable support for prueba
```
